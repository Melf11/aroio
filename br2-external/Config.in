## br2-external/Config.in
```kconfig
menu "Aroio"
	source "$BR2_EXTERNAL_AROIO_PATH/package/camilladsp/Config.in"
	source "$BR2_EXTERNAL_AROIO_PATH/package/aroiod/Config.in"
	source "$BR2_EXTERNAL_AROIO_PATH/package/aroio-web/Config.in"
	source "$BR2_EXTERNAL_AROIO_PATH/package/librespot/Config.in"
	source "$BR2_EXTERNAL_AROIO_PATH/package/aroio-shairport/Config.in"
	source "$BR2_EXTERNAL_AROIO_PATH/package/aroio-nqptp/Config.in"
endmenu
```

## br2-external/configs/aroio_rpi_defconfig
```kconfig
# AroioOS, Raspberry Pi 3B/3B+/4/5, aarch64. DRAFT: verify with `make` (phase 0).
BR2_aarch64=y
BR2_cortex_a53=y
BR2_CCACHE=y
BR2_GLOBAL_PATCH_DIR="$(BR2_EXTERNAL_AROIO_PATH)/patches"
BR2_TOOLCHAIN_BUILDROOT_GLIBC=y
BR2_TOOLCHAIN_BUILDROOT_CXX=y
BR2_TOOLCHAIN_BUILDROOT_FORTRAN=y

# system
BR2_INIT_SYSTEMD=y
BR2_TARGET_GENERIC_HOSTNAME="aroio"
BR2_TARGET_GENERIC_ISSUE="AroioOS"
# no root password login at all (dropbear also refuses keys for accounts with a blank password);
# development images get the developer's SSH key
# BR2_TARGET_ENABLE_ROOT_LOGIN is not set
BR2_SYSTEM_BIN_SH_BASH=y
# read-only root (squashfs): /var is a tmpfs filled from /usr/share/factory
# BR2_TARGET_GENERIC_REMOUNT_ROOTFS_RW is not set
BR2_INIT_SYSTEMD_VAR_FACTORY=y
BR2_ROOTFS_MERGED_USR=y
BR2_ROOTFS_OVERLAY="$(BR2_EXTERNAL_AROIO_PATH)/board/rpi/overlay"
BR2_ROOTFS_USERS_TABLES="$(BR2_EXTERNAL_AROIO_PATH)/board/rpi/users.txt"
BR2_ROOTFS_POST_BUILD_SCRIPT="$(BR2_EXTERNAL_AROIO_PATH)/board/rpi/post-build.sh"
BR2_ROOTFS_POST_IMAGE_SCRIPT="$(BR2_EXTERNAL_AROIO_PATH)/board/rpi/post-image.sh"

# kernel: Raspberry Pi kernel, branch rpi-6.18.y (pinned commit)
BR2_LINUX_KERNEL=y
BR2_LINUX_KERNEL_CUSTOM_TARBALL=y
BR2_LINUX_KERNEL_CUSTOM_TARBALL_LOCATION="$(call github,raspberrypi,linux,ea17ae02ca28483e508b05c7c44190c01a1ef8eb)/linux-ea17ae02ca28483e508b05c7c44190c01a1ef8eb.tar.gz"
BR2_LINUX_KERNEL_DEFCONFIG="bcm2711"
BR2_KERNEL_HEADERS_AS_KERNEL=y
BR2_PACKAGE_HOST_LINUX_HEADERS_CUSTOM_6_18=y
BR2_LINUX_KERNEL_CONFIG_FRAGMENT_FILES="$(BR2_EXTERNAL_AROIO_PATH)/board/rpi/linux.fragment"
BR2_LINUX_KERNEL_IMAGE=y
BR2_LINUX_KERNEL_DTS_SUPPORT=y
BR2_LINUX_KERNEL_INTREE_DTS_NAME="broadcom/bcm2710-rpi-3-b broadcom/bcm2710-rpi-3-b-plus broadcom/bcm2711-rpi-4-b broadcom/bcm2711-rpi-cm4 broadcom/bcm2712-rpi-5-b broadcom/bcm2712-rpi-cm5-cm5io"
BR2_LINUX_KERNEL_DTB_OVERLAY_SUPPORT=y
BR2_LINUX_KERNEL_NEEDS_HOST_OPENSSL=y
BR2_LINUX_KERNEL_INSTALL_TARGET=y
BR2_PACKAGE_RPI_FIRMWARE=y
BR2_PACKAGE_RPI_FIRMWARE_BOOTCODE_BIN=y
BR2_PACKAGE_RPI_FIRMWARE_VARIANT_PI=y
BR2_PACKAGE_RPI_FIRMWARE_VARIANT_PI4=y
BR2_PACKAGE_RPI_FIRMWARE_CONFIG_FILE="$(BR2_EXTERNAL_AROIO_PATH)/board/rpi/config.txt"
BR2_PACKAGE_RPI_FIRMWARE_CMDLINE_FILE="$(BR2_EXTERNAL_AROIO_PATH)/board/rpi/cmdline.txt"
BR2_PACKAGE_RPI_FIRMWARE_INSTALL_DTB_OVERLAYS=y
BR2_PACKAGE_LINUX_FIRMWARE=y
BR2_PACKAGE_LINUX_FIRMWARE_BRCM_BCM43XX=y
BR2_PACKAGE_LINUX_FIRMWARE_BRCM_BCM43XXX=y

# images: read-only squashfs, A/B with RAUC
BR2_TARGET_ROOTFS_SQUASHFS=y
BR2_TARGET_ROOTFS_SQUASHFS4_ZSTD=y
# BR2_TARGET_ROOTFS_TAR is not set
BR2_PACKAGE_HOST_GENIMAGE=y
BR2_PACKAGE_HOST_DOSFSTOOLS=y
BR2_PACKAGE_HOST_MTOOLS=y
BR2_PACKAGE_RAUC=y
BR2_PACKAGE_HOST_RAUC=y
BR2_PACKAGE_E2FSPROGS=y
BR2_PACKAGE_E2FSPROGS_RESIZE2FS=y

# audio
BR2_PACKAGE_ALSA_UTILS=y
BR2_PACKAGE_ALSA_UTILS_APLAY=y
BR2_PACKAGE_ALSA_UTILS_AMIXER=y
BR2_PACKAGE_CAMILLADSP=y
BR2_PACKAGE_SQUEEZELITE=y
BR2_PACKAGE_SQUEEZELITE_FFMPEG=y
BR2_PACKAGE_SQUEEZELITE_DSD=y
BR2_PACKAGE_SHAIRPORT_SYNC=y
BR2_PACKAGE_SHAIRPORT_SYNC_AIRPLAY2=y
BR2_PACKAGE_MPD=y
BR2_PACKAGE_UPMPDCLI=y
BR2_PACKAGE_BLUEZ5_UTILS=y
BR2_PACKAGE_BLUEZ5_UTILS_CLIENT=y
BR2_PACKAGE_BLUEZ_ALSA=y
BR2_PACKAGE_BLUEZ_TOOLS=y
BR2_PACKAGE_BRCMFMAC_SDIO_FIRMWARE_RPI=y
BR2_PACKAGE_BRCMFMAC_SDIO_FIRMWARE_RPI_BT=y
# LDAC / aptX HD: own packages for libldac and libopenaptx (phase 1)

# network
BR2_PACKAGE_IWD=y
BR2_PACKAGE_IPROUTE2=y
BR2_PACKAGE_IW=y
BR2_PACKAGE_WIRELESS_REGDB=y
BR2_PACKAGE_AVAHI=y
BR2_PACKAGE_AVAHI_DAEMON=y
BR2_PACKAGE_HOSTAPD=y
BR2_PACKAGE_HOSTAPD_DRIVER_NL80211=y
BR2_PACKAGE_DNSMASQ=y
BR2_PACKAGE_DROPBEAR=y

# control
BR2_PACKAGE_PYTHON3=y
BR2_PACKAGE_PYTHON_AIOHTTP=y
BR2_PACKAGE_PYTHON_NUMPY=y
BR2_PACKAGE_PYTHON_SCIPY=y
BR2_PACKAGE_LIBV4L=y
BR2_PACKAGE_LIBV4L_UTILS=y
BR2_PACKAGE_AROIOD=y
BR2_PACKAGE_AROIO_WEB=y
```

## br2-external/package/aroio-nqptp/Config.in
```kconfig
config BR2_PACKAGE_AROIO_NQPTP
	bool "aroio-nqptp"
	depends on BR2_USE_MMU
	select BR2_PACKAGE_LIBCONFIG
	help
	  NQPTP 1.2.9, the timing companion of Shairport Sync 5.6 (AirPlay 2).
	  Buildroot ships 1.2.4; replaces BR2_PACKAGE_NQPTP.

	  https://github.com/mikebrady/nqptp
```

## br2-external/package/aroio-shairport/Config.in
```kconfig
config BR2_PACKAGE_AROIO_SHAIRPORT
	bool "aroio-shairport"
	depends on BR2_TOOLCHAIN_HAS_THREADS_NPTL
	depends on BR2_INSTALL_LIBSTDCPP
	depends on BR2_USE_WCHAR # libglib2
	depends on BR2_USE_MMU
	depends on BR2_PACKAGE_FFMPEG_ARCH_SUPPORTS
	depends on BR2_PACKAGE_LIBGPG_ERROR_ARCH_SUPPORTS
	select BR2_PACKAGE_AROIO_NQPTP # runtime
	select BR2_PACKAGE_ALSA_LIB
	select BR2_PACKAGE_ALSA_LIB_MIXER
	select BR2_PACKAGE_LIBCONFIG
	select BR2_PACKAGE_OPENSSL
	select BR2_PACKAGE_POPT
	select BR2_PACKAGE_AVAHI
	select BR2_PACKAGE_AVAHI_DAEMON
	select BR2_PACKAGE_DBUS
	select BR2_PACKAGE_LIBGLIB2
	select BR2_PACKAGE_LIBPLIST
	select BR2_PACKAGE_LIBSODIUM
	select BR2_PACKAGE_LIBGCRYPT
	select BR2_PACKAGE_FFMPEG
	select BR2_PACKAGE_UTIL_LINUX
	select BR2_PACKAGE_UTIL_LINUX_LIBUUID
	help
	  Shairport Sync 5.6 with AirPlay 2, metadata pipe and the D-Bus
	  interface: from 5.6 on the receiver can remote-control AirPlay 2
	  senders (pause without ending the session, skip). Buildroot ships
	  4.3.7; replaces BR2_PACKAGE_SHAIRPORT_SYNC.

	  https://github.com/mikebrady/shairport-sync
```

## br2-external/package/aroio-web/Config.in
```kconfig
config BR2_PACKAGE_AROIO_WEB
	bool "aroio-web"
	help
	  The Aroio app (PWA), prebuilt from web/ (make web).
```

## br2-external/package/aroiod/Config.in
```kconfig
config BR2_PACKAGE_AROIOD
	bool "aroiod"
	depends on BR2_PACKAGE_PYTHON3
	select BR2_PACKAGE_PYTHON_AIOHTTP
	select BR2_PACKAGE_PYTHON_NUMPY
	select BR2_PACKAGE_PYTHON_SCIPY
	help
	  Aroio control service: API, playback, DSP, room correction.
```

## br2-external/package/camilladsp/Config.in
```kconfig
config BR2_PACKAGE_CAMILLADSP
	bool "camilladsp"
	depends on BR2_PACKAGE_HOST_RUSTC_TARGET_ARCH_SUPPORTS
	select BR2_PACKAGE_HOST_RUSTC
	select BR2_PACKAGE_ALSA_LIB
	help
	  Audio processing engine (FIR, IIR, mixers, volume) with a
	  websocket control interface.

	  https://github.com/HEnquist/camilladsp
```

## br2-external/package/font-inter/Config.in
```kconfig
config BR2_PACKAGE_FONT_INTER
	bool "font-inter"
	help
	  Inter (rsms.me/inter), the typeface of the HDMI info screen.
	  Regular, SemiBold and Bold only.
```

## br2-external/package/librespot/Config.in
```kconfig
config BR2_PACKAGE_LIBRESPOT
	bool "librespot"
	depends on BR2_PACKAGE_HOST_RUSTC_TARGET_ARCH_SUPPORTS
	select BR2_PACKAGE_HOST_RUSTC
	select BR2_PACKAGE_ALSA_LIB
	select BR2_PACKAGE_OPENSSL
	help
	  Open source Spotify Connect receiver.

	  https://github.com/librespot-org/librespot
```
